// SPDX-License-Identifier: MIT
// Generated by tools/guition/migrate_s3_boards.py.
#include "sdkconfig.h"
#if CONFIG_GUITION_BOARD_NO_PSRAM && CONFIG_SPIRAM
#error "This board has no PSRAM; disable CONFIG_SPIRAM."
#endif
#include "esp_board_manager_includes.h"
#include "esp_board_entry.h"
#include "esp_board_manager.h"
#include "esp_lcd_touch.h"
#include "esp_lcd_st7701.h"
#include "lcd_init_commands.h"

esp_err_t lcd_panel_factory_entry_t(esp_lcd_panel_io_handle_t io,
                                      const esp_lcd_panel_dev_config_t *config,
                                      esp_lcd_panel_handle_t *out)
{
    if (!config || !out) return ESP_ERR_INVALID_ARG;
    // BMGR stores the RGB configuration; the controller needs its own wrapper.
    dev_display_lcd_config_t *board = NULL;
    esp_err_t ret = esp_board_manager_get_device_config("display_lcd", (void **)&board);
    if (ret != ESP_OK) return ret;
    if (!board) return ESP_ERR_INVALID_STATE;
    st7701_vendor_config_t vendor = {
        .rgb_config = &board->sub_cfg.rgb_3wire_spi.rgb_panel_config,
        .init_cmds = guition_lcd_init_cmds,
        .init_cmds_size = sizeof(guition_lcd_init_cmds) / sizeof(guition_lcd_init_cmds[0]),
        // BMGR owns the IO through deinit. The panel must not delete it.
        .flags = { .auto_del_panel_io = 0, .mirror_by_cmd = 0 },
    };
    esp_lcd_panel_dev_config_t panel = *config;
    panel.vendor_config = &vendor;
    return esp_lcd_new_panel_st7701(io, &panel, out);
}

#if CONFIG_GUITION_TOUCH_CAPACITIVE
#include "esp_lcd_touch_gt911.h"
#endif

esp_err_t lcd_touch_factory_entry_t(esp_lcd_panel_io_handle_t io,
                                    const esp_lcd_touch_config_t *config,
                                    esp_lcd_touch_handle_t *out)
{
#if CONFIG_GUITION_TOUCH_CAPACITIVE
    return esp_lcd_touch_new_i2c_gt911(io, config, out);
#else
    (void)io;
    (void)config;
    if (out) {
        *out = NULL;
    }
    return ESP_ERR_NOT_SUPPORTED;
#endif
}
