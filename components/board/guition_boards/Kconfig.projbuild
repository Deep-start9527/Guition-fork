## components/board/guition_boards/esp32_8048s050/Kconfig.projbuild
```kconfig
# SPDX-License-Identifier: MIT
if ESP_BOARD_ESP32_8048S050 && IDF_TARGET_ESP32S3

config GUITION_ESP32_8048S050_TOUCH_PROFILE
    bool
    default y
    select GUITION_BOARD_TOUCH_SELECT
    select GUITION_HAS_CAP_TOUCH

config GUITION_BOARD_TOUCH_SELECT
    bool
    help
        The selected board provides selectable touch devices.

config GUITION_BOARD_NO_PSRAM
    bool
    default y if GUITION_BOARD_TOUCH_SELECT && (IDF_TARGET_ESP32 || IDF_TARGET_ESP32C3)
    help
        Guition ESP32 and ESP32-C3 boards have no PSRAM. Use internal RAM
        task stacks and partial display buffers; CONFIG_SPIRAM is rejected.

menu "Guition touch"
    depends on GUITION_BOARD_TOUCH_SELECT

config GUITION_HAS_CAP_TOUCH
    bool

config GUITION_HAS_RES_TOUCH
    bool

config GUITION_DEFAULT_RES_TOUCH
    bool

config GUITION_DEFAULT_NO_TOUCH
    bool

choice GUITION_TOUCH_TYPE
    prompt "Touch variant"
    default GUITION_TOUCH_NONE if GUITION_DEFAULT_NO_TOUCH
    default GUITION_TOUCH_RESISTIVE if GUITION_DEFAULT_RES_TOUCH && GUITION_HAS_RES_TOUCH
    default GUITION_TOUCH_CAPACITIVE if GUITION_HAS_CAP_TOUCH
    default GUITION_TOUCH_NONE

config GUITION_TOUCH_NONE
    bool "No touch"
    help
        Keep LCD support; do not acquire a touch bus or create touch IO/driver.

config GUITION_TOUCH_CAPACITIVE
    bool "Capacitive touch"
    depends on GUITION_HAS_CAP_TOUCH
    select ESP_BOARD_PERIPH_I2C_SUPPORT

config GUITION_TOUCH_RESISTIVE
    bool "Resistive touch (XPT2046)"
    depends on GUITION_HAS_RES_TOUCH
    select ESP_BOARD_PERIPH_SPI_SUPPORT

endchoice

endmenu

config GUITION_BOARD_HAS_SD
    bool
    default y

config GUITION_SD_ENABLED
    bool "Enable Guition SD card support"
    depends on GUITION_BOARD_HAS_SD
    default n
    select ESP_BOARD_DEV_FS_FAT_SUPPORT
    select ESP_BOARD_PERIPH_SPI_SUPPORT

endif
```

## components/board/guition_boards/jc1060p470_i_w_y/Kconfig.projbuild
```kconfig
# SPDX-License-Identifier: MIT
if ESP_BOARD_JC1060P470_I_W_Y && IDF_TARGET_ESP32P4

menu "Guition JC1060P470 display"

config GUITION_JC1060_LCD_V2_AVAILABLE
    bool
    default y

choice GUITION_JC1060_LCD_TYPE
    prompt "LCD variant"
    default GUITION_JC1060_LCD_V2

config GUITION_JC1060_LCD_V1
    bool "LCD V1 (existing JD9165 screen)"

config GUITION_JC1060_LCD_V2
    bool "LCD V2 (JD9165, HBP 136)"
    depends on GUITION_JC1060_LCD_V2_AVAILABLE

endchoice

endmenu

endif
```

## components/board/guition_boards/jc3636f118/sdkconfig.defaults.board
```kconfig
CONFIG_ESP_DEFAULT_CPU_FREQ_MHZ_320=y
CONFIG_ESPTOOLPY_FLASHMODE_QIO=y
CONFIG_ESPTOOLPY_FLASHFREQ_80M=y
CONFIG_ESPTOOLPY_FLASHSIZE_16MB=y
CONFIG_SPIRAM=y
CONFIG_SPIRAM_MODE_OCT=y
CONFIG_SPIRAM_SPEED_200M=y
CONFIG_SPIRAM_XIP_FROM_PSRAM=y
CONFIG_SPIRAM_USE_MALLOC=y
CONFIG_ESP_BOARD_DEV_DISPLAY_LCD_SUPPORT=y
CONFIG_ESP_BOARD_DEV_DISPLAY_LCD_SUB_SPI_SUPPORT=y
CONFIG_ESP_BOARD_DEV_CUSTOM_SUPPORT=y
CONFIG_ESP_BOARD_PERIPH_LEDC_SUPPORT=y
CONFIG_ESP_BOARD_DEV_LEDC_CTRL_SUPPORT=y
CONFIG_ESP_BOARD_PERIPH_SPI_SUPPORT=y
```

## components/board/guition_boards/jc4880p443/Kconfig.projbuild
```kconfig
# SPDX-License-Identifier: MIT
if ESP_BOARD_JC4880P443 && IDF_TARGET_ESP32P4

config GUITION_BOARD_HAS_SD
    bool
    default y

config GUITION_SD_ENABLED
    bool "Enable Guition SD card support"
    depends on GUITION_BOARD_HAS_SD
    default n
    select ESP_BOARD_DEV_FS_FAT_SUPPORT

endif
```

## components/board/guition_boards/jc5454f328/sdkconfig.defaults.board
```kconfig
# ESP32-S31 octal PSRAM and 80 MHz flash.
CONFIG_SPIRAM=y
CONFIG_SPIRAM_MODE_OCT=y
CONFIG_SPIRAM_SPEED_200M=y
CONFIG_SPIRAM_USE_MALLOC=y
CONFIG_ESPTOOLPY_FLASHMODE_QIO=y
CONFIG_ESPTOOLPY_FLASHFREQ_80M=y
CONFIG_ESP_DEFAULT_CPU_FREQ_MHZ_240=y
CONFIG_ESP_BOARD_DEV_DISPLAY_LCD_SUPPORT=y
CONFIG_ESP_BOARD_DEV_CUSTOM_SUPPORT=y
CONFIG_ESPTOOLPY_FLASHSIZE_16MB=y
CONFIG_ESP_BOARD_DEV_DISPLAY_LCD_SUB_RGB_3WIRE_SPI_SUPPORT=y
CONFIG_ESP_BOARD_PERIPH_LEDC_SUPPORT=y
CONFIG_ESP_BOARD_DEV_LEDC_CTRL_SUPPORT=y
CONFIG_ESP_BOARD_PERIPH_GPIO_SUPPORT=y
CONFIG_ESP_BOARD_PERIPH_I2C_SUPPORT=y
CONFIG_ESP_BOARD_PERIPH_I2S_SUPPORT=y
CONFIG_ESP_BOARD_DEV_AUDIO_CODEC_SUPPORT=y
CONFIG_CODEC_ES7210_SUPPORT=y
CONFIG_CODEC_DUMMY_SUPPORT=y
```

## example/FactoryDemo/JC1060F570-FactoryDemo/main/Kconfig.projbuild
```kconfig
menu "FactoryDemo Configuration"

    choice FACTORY_DESKTOP_ICON_SOURCE
        prompt "Desktop icon source"
        default FACTORY_DESKTOP_ICONS_SPIFFS
        help
            Select PNG files in the assets SPIFFS partition or LVGL image
            descriptors compiled into the application for the selected panel.

        config FACTORY_DESKTOP_ICONS_SPIFFS
            bool "PNG files from SPIFFS"

        config FACTORY_DESKTOP_ICONS_EMBEDDED
            bool "Predecoded C images"
    endchoice

    config FACTORY_SNTP_SERVER
        string "SNTP server"
        default "pool.ntp.org"
        help
            Hostname used by the FactoryDemo time service after station IPv4 acquisition.

    config FACTORY_UART_ENABLE
        bool "Enable UART terminal"
        default y
        help
            Enable the UART terminal application and its background RX task.

    if FACTORY_UART_ENABLE

    config FACTORY_UART_PORT
        int "UART port number"
        range 0 4
        default 1
        help
            UART controller used by the terminal. Select a port that is not
            reserved by the console or another peripheral.

    config FACTORY_UART_TX_GPIO
        int "UART TX GPIO"
        range -1 61
        default 53 if ESP_BOARD_JC8048F550 || ESP_BOARD_JC8048F543
        default 14 if ESP_BOARD_JC1060F570C
        default 18
        help
            GPIO used for UART TX. Set to -1 to leave the TX signal unused.
            JC8048F550 / JC8048F543 use fixed UART1 TX GPIO53.

    config FACTORY_UART_RX_GPIO
        int "UART RX GPIO"
        range -1 61
        default 52 if ESP_BOARD_JC8048F550 || ESP_BOARD_JC8048F543
        default 11 if ESP_BOARD_JC1060F570C
        default 19
        help
            GPIO used for UART RX. Set to -1 to leave the RX signal unused.
            JC8048F550 / JC8048F543 use fixed UART1 RX GPIO52.

    config FACTORY_UART_BAUD_RATE
        int "UART baud rate"
        range 300 5000000
        default 115200
        help
            UART baud rate.

    config FACTORY_UART_RX_BUFFER_SIZE
        int "UART RX buffer size"
        range 256 16384
        default 2048
        help
            Driver RX buffer size in bytes.

    config FACTORY_UART_MESSAGE_MAX_LENGTH
        int "Maximum message length"
        range 32 512
        default 128
        help
            Maximum text bytes stored for one received or transmitted message.
            The terminal keeps at most 100 messages and evicts the oldest one.

    endif

endmenu

# Application defaults follow the selected board's Ethernet hardware.
config ETHERNET_INIT_DEFAULT_ETH_DISABLED
    default y if !ESP_BOARD_JC1060F570C

config ETHERNET_INIT_OVERRIDE_DISABLE
    default y if ESP_BOARD_JC8048F550 || ESP_BOARD_JC8048F543

config ETHERNET_INTERNAL_SUPPORT
    default y if ESP_BOARD_JC1060F570C

if ESP_BOARD_JC1060F570C && ETHERNET_INTERNAL_SUPPORT

choice ETHERNET_PHY_INTERFACE
    default ETHERNET_PHY_INTERFACE_RMII
endchoice

choice ETHERNET_PHY_MODEL
    default ETHERNET_PHY_IP101
endchoice

if ETHERNET_PHY_INTERFACE_RMII

choice ETHERNET_RMII_CLK_MODE
    default ETHERNET_RMII_CLK_INPUT
endchoice

config ETHERNET_RMII_CLK_GPIO
    default 13

config ETHERNET_RMII_TX_EN_GPIO
    default 12

config ETHERNET_RMII_TXD0_GPIO
    default 8

config ETHERNET_RMII_TXD1_GPIO
    default 9

config ETHERNET_RMII_CRS_DV_GPIO
    default 15

config ETHERNET_RMII_RXD0_GPIO
    default 19

config ETHERNET_RMII_RXD1_GPIO
    default 18

endif

config ETHERNET_MDC_GPIO
    default 53

config ETHERNET_MDIO_GPIO
    default 10

config ETHERNET_PHY_RST_GPIO
    default 17

endif
```

## example/display/display_lv_demo_widgets/main/Kconfig.projbuild
```kconfig
menu "Demo display"

config DEMO_SPI_DRAW_BUFFER_LINES
    int "SPI partial draw buffer lines (non-TE displays)"
    depends on ESP_BOARD_DEV_DISPLAY_LCD_SUB_SPI_SUPPORT && !ESP_BOARD_JC3248W535
    range 4 40
    default 20
    help
        Larger strips reduce flush overhead but use more internal RAM.
        This does not synchronize writes with panel scanning.

config DEMO_SPI_DOUBLE_DRAW_BUFFER
    bool "SPI double draw buffers (non-TE displays)"
    depends on ESP_BOARD_DEV_DISPLAY_LCD_SUB_SPI_SUPPORT && !ESP_BOARD_JC3248W535
    default y
    help
        Render the next strip while the previous strip is transferred.
        Uses two internal RAM draw buffers; software rotation additionally
        needs one DMA strip buffer. Disable to reduce memory use.
        These are LVGL draw buffers, not RGB/MIPI panel num_fbs.

config DEMO_LCD_HARDWARE_ROTATION_SUPPORTED
    bool
    default y if (IDF_TARGET_ESP32 || IDF_TARGET_ESP32C3) && (ESP_BOARD_ESP32_2424S012 || ESP_BOARD_ESP32_2432S024 || ESP_BOARD_ESP32_2432S028 || ESP_BOARD_ESP32_2432S032 || ESP_BOARD_JC2432W328)
    default y if ESP_BOARD_JC3636K518 || ESP_BOARD_JC3636K718 || ESP_BOARD_JC3636W518 || ESP_BOARD_JC3636F118

config DEMO_LCD_HARDWARE_180_SUPPORTED
    bool
    default y if ESP_BOARD_DEV_DISPLAY_LCD_SUB_SPI_SUPPORT || ESP_BOARD_DEV_DISPLAY_LCD_SUB_DSI_SUPPORT

choice DEMO_LCD_ROTATION_ANGLE
    prompt "Display rotation angle"
    default DEMO_LCD_ROTATION_90 if ESP_BOARD_JC3248W535
    default DEMO_LCD_ROTATION_0
    help
        Rotation relative to the board's LCD orientation. Touch coordinates
        follow the same rotation. 90 and 270 degrees exchange logical width
        and height. Angles follow ESP LVGL Adapter rotation conventions.

config DEMO_LCD_ROTATION_0
    bool "0 degrees"
config DEMO_LCD_ROTATION_90
    bool "90 degrees"
config DEMO_LCD_ROTATION_180
    bool "180 degrees"
config DEMO_LCD_ROTATION_270
    bool "270 degrees"
endchoice

config DEMO_LCD_ROTATION_DEGREES
    int
    default 90 if DEMO_LCD_ROTATION_90
    default 180 if DEMO_LCD_ROTATION_180
    default 270 if DEMO_LCD_ROTATION_270
    default 0

choice DEMO_LCD_ROTATION_MODE
    prompt "Display rotation method"
    default DEMO_LCD_ROTATION_HARDWARE if DEMO_LCD_HARDWARE_ROTATION_SUPPORTED
    default DEMO_LCD_ROTATION_SOFTWARE

config DEMO_LCD_ROTATION_HARDWARE
    bool "Hardware (LCD controller)"
    depends on DEMO_LCD_HARDWARE_ROTATION_SUPPORTED || (DEMO_LCD_ROTATION_180 && DEMO_LCD_HARDWARE_180_SUPPORTED)
    help
        Use panel axis swapping and mirroring on supported ESP32, ESP32-C3
        and JC3636 displays up to 360x360. Larger supported command-driven
        panels can use hardware mirroring at 180 degrees only. RGB panels
        using CPU mirror/copy operations require software rotation.

config DEMO_LCD_ROTATION_SOFTWARE
    bool "Software (LVGL adapter)"
    help
        Rotate pixels through the LVGL adapter. Ordinary SPI displays use
        its draw callback with an additional DMA strip buffer. RGB/MIPI
        displays use the selected frame buffer and refresh mode.

endchoice

config DEMO_LCD_SINGLE_FRAME_BUFFER
    bool "RGB/MIPI single frame buffer (requires board num_fbs = 1)"
    depends on ESP_BOARD_DEV_DISPLAY_LCD_SUB_RGB_SUPPORT || ESP_BOARD_DEV_DISPLAY_LCD_SUB_RGB_3WIRE_SPI_SUPPORT || ESP_BOARD_DEV_DISPLAY_LCD_SUB_DSI_SUPPORT
    depends on DEMO_LCD_ROTATION_0 || DEMO_LCD_ROTATION_HARDWARE
    default n
    help
        Use one panel frame buffer with a small LVGL draw buffer. Tearing may
        occur. Supports zero rotation or hardware rotation, not software
        rotation. Set board num_fbs to 1 and regenerate with bmgr to save PSRAM.
        This option does not change board allocation and is ignored when the
        board provides multiple frame buffers. When the board provides only
        one frame buffer, this mode is selected automatically if compatible.

choice DEMO_LCD_RGB_MIPI_REFRESH
    prompt "RGB/MIPI software rotation refresh mode"
    depends on DEMO_LCD_ROTATION_SOFTWARE && !DEMO_LCD_ROTATION_0
    depends on ESP_BOARD_DEV_DISPLAY_LCD_SUB_RGB_SUPPORT || ESP_BOARD_DEV_DISPLAY_LCD_SUB_RGB_3WIRE_SPI_SUPPORT || ESP_BOARD_DEV_DISPLAY_LCD_SUB_DSI_SUPPORT
    default DEMO_LCD_REFRESH_DOUBLE_PARTIAL
    help
        Configure board_devices.yaml before regenerating the board with bmgr.
        RGB uses config.rgb_panel_config.num_fbs; MIPI uses
        config.dpi_config.num_fbs. These options do not change board buffers.

config DEMO_LCD_REFRESH_DOUBLE_PARTIAL
    bool "Double buffer, partial refresh (board num_fbs = 2)"
    help
        Rotate partial draw buffers into two panel frame buffers.

config DEMO_LCD_REFRESH_TRIPLE_PARTIAL
    bool "Triple buffer, partial refresh (board num_fbs = 3)"
    help
        Requires three panel frame buffers for software rotation.

config DEMO_LCD_REFRESH_DOUBLE_FULL
    bool "Double buffer, full refresh (rotation requires board num_fbs = 3)"
    help
        The adapter's DOUBLE_FULL rotation path requires a third panel frame
        buffer as the drawing/rotation source, despite the mode name.

config DEMO_LCD_REFRESH_TRIPLE_FULL
    bool "Triple buffer, full refresh (board num_fbs = 3)"
    help
        Requires three panel frame buffers and redraws the entire screen.

endchoice

endmenu
```

## example/display/touch_draw/main/Kconfig.projbuild
```kconfig
menu "Demo display"

config DEMO_TOUCH_POINTERS
    int "Touch pointer count"
    range 1 ESP_LCD_TOUCH_MAX_POINTS if ESP_LCD_TOUCH_MAX_POINTS < 5
    range 1 5
    default 5
    help
        Number of touch pointers exposed to LVGL. One uses single-touch
        mode; larger values use multi-control mode. Simultaneous contacts
        also depend on the touch controller's capabilities.

endmenu
```

## example/display/touch_draw/sdkconfig.defaults
```kconfig
# Espressif IoT Development Framework (ESP-IDF) 6.1.0
CONFIG_PARTITION_TABLE_SINGLE_APP=y
CONFIG_COMPILER_OPTIMIZATION_SIZE=y
CONFIG_LV_COLOR_DEPTH_16=y
CONFIG_LV_MEM_SIZE=65536
# CONFIG_LV_USE_FREETYPE is not set
# CONFIG_LV_USE_FS_POSIX is not set
# CONFIG_LV_USE_FS_MEMFS is not set
# CONFIG_ESP_LVGL_ADAPTER_ENABLE_FREETYPE is not set
# CONFIG_ESP_LVGL_ADAPTER_ENABLE_FS is not set
# CONFIG_ESP_LVGL_ADAPTER_ENABLE_DECODER is not set
# CONFIG_ESP_LVGL_ADAPTER_ENABLE_BUTTON is not set
# CONFIG_ESP_LVGL_ADAPTER_ENABLE_KNOB is not set
CONFIG_LV_USE_CLIB_MALLOC=y
CONFIG_LV_USE_CANVAS=y
# CONFIG_LV_BUILD_EXAMPLES is not set
# CONFIG_LV_BUILD_DEMOS is not set
# CONFIG_LV_USE_DEMO_WIDGETS is not set

# Only the canvas, image base, label and button widgets are needed.
# CONFIG_LV_USE_ANIMIMG is not set
# CONFIG_LV_USE_ARC is not set
# CONFIG_LV_USE_ARCLABEL is not set
# CONFIG_LV_USE_BAR is not set
# CONFIG_LV_USE_BUTTONMATRIX is not set
# CONFIG_LV_USE_CALENDAR is not set
# CONFIG_LV_USE_CHART is not set
# CONFIG_LV_USE_CHECKBOX is not set
# CONFIG_LV_USE_DROPDOWN is not set
# CONFIG_LV_USE_IMAGEBUTTON is not set
# CONFIG_LV_USE_KEYBOARD is not set
# CONFIG_LV_USE_LED is not set
# CONFIG_LV_USE_LINE is not set
# CONFIG_LV_USE_LIST is not set
# CONFIG_LV_USE_MENU is not set
# CONFIG_LV_USE_MSGBOX is not set
# CONFIG_LV_USE_ROLLER is not set
# CONFIG_LV_USE_SCALE is not set
# CONFIG_LV_USE_SLIDER is not set
# CONFIG_LV_USE_SPAN is not set
# CONFIG_LV_USE_SPINBOX is not set
# CONFIG_LV_USE_SPINNER is not set
# CONFIG_LV_USE_SWITCH is not set
# CONFIG_LV_USE_TEXTAREA is not set
# CONFIG_LV_USE_TABLE is not set
# CONFIG_LV_USE_TABVIEW is not set
# CONFIG_LV_USE_TILEVIEW is not set
# CONFIG_LV_USE_WIN is not set
# CONFIG_LV_USE_THEME_SIMPLE is not set
# CONFIG_LV_USE_THEME_MONO is not set
# CONFIG_LV_USE_FLEX is not set
# CONFIG_LV_USE_GRID is not set
# CONFIG_LV_USE_OBSERVER is not set

CONFIG_SPIRAM_XIP_FROM_PSRAM=y
# CONFIG_BOOTLOADER_FLASH_XMC_SUPPORT is not set
# CONFIG_SPI_FLASH_BROWNOUT_RESET_XMC is not set
```
