// SPDX-License-Identifier: MIT
// Generated by tools/guition/migrate_s3_boards.py.
#include "sdkconfig.h"
#if CONFIG_GUITION_BOARD_NO_PSRAM && CONFIG_SPIRAM
#error "This board has no PSRAM; disable CONFIG_SPIRAM."
#endif
#include "esp_board_manager_includes.h"
#include "esp_board_entry.h"
#include "esp_board_manager.h"
#include "esp_lcd_touch.h"
#include "esp_lcd_axs15231b.h"
#include "esp_lcd_panel_interface.h"
#include "lcd_init_commands.h"

static esp_err_t (*axs15231b_disp_off)(esp_lcd_panel_t *panel, bool off);

static esp_err_t panel_disp_on_off(esp_lcd_panel_t *panel, bool on)
{
    // AXS15231B 2.1.0 uses the legacy "off" argument on the modern callback.
    return axs15231b_disp_off(panel, !on);
}

esp_err_t lcd_panel_factory_entry_t(esp_lcd_panel_io_handle_t io,
                                      const esp_lcd_panel_dev_config_t *config,
                                      esp_lcd_panel_handle_t *out)
{
    if (!config || !out) return ESP_ERR_INVALID_ARG;
    axs15231b_vendor_config_t vendor = {
        .init_cmds = guition_lcd_init_cmds,
        .init_cmds_size = sizeof(guition_lcd_init_cmds) / sizeof(guition_lcd_init_cmds[0]),
        .flags = { .use_qspi_interface = 1 },
    };
    esp_lcd_panel_dev_config_t panel = *config;
    panel.vendor_config = &vendor;
    esp_err_t ret = esp_lcd_new_panel_axs15231b(io, &panel, out);
    if (ret == ESP_OK) {
        axs15231b_disp_off = (*out)->disp_on_off;
        (*out)->disp_on_off = panel_disp_on_off;
    }
    return ret;
}

#if CONFIG_GUITION_TOUCH_CAPACITIVE
#include "esp_lcd_axs15231b.h"
#endif

esp_err_t lcd_touch_factory_entry_t(esp_lcd_panel_io_handle_t io,
                                    const esp_lcd_touch_config_t *config,
                                    esp_lcd_touch_handle_t *out)
{
#if CONFIG_GUITION_TOUCH_CAPACITIVE
    return esp_lcd_touch_new_i2c_axs15231b(io, config, out);
#else
    (void)io;
    (void)config;
    if (out) {
        *out = NULL;
    }
    return ESP_ERR_NOT_SUPPORTED;
#endif
}
